/**
 * automatically applied on subsequent loads via the GUI or CLI.
 */
//@cliArgs --device "MSPM0G350X" --package "LQFP-64(PM)" --part "Default"
//@v2CliArgs --device "MSPM0G3507" --package "LQFP-64(PM)"
// @cliArgs --board /ti/boards/LP_MSPM0G3507 --rtos nortos

const Board = scripting.addModule("/ti/driverlib/Board");
const SYSCTL = scripting.addModule("/ti/driverlib/SYSCTL");
const ADC12 = scripting.addModule("/ti/driverlib/ADC12", {}, false);
const ADC12Instance = ADC12.addInstance();
const TIMER = scripting.addModule("/ti/driverlib/TIMER", {}, false);
const TIMERInstance = TIMER.addInstance();
const GPIO = scripting.addModule("/ti/driverlib/GPIO", {}, false);
const ValidationGPIO = GPIO.addInstance();

ADC12Instance.$name = "SIGNAL_ADC";
ADC12Instance.sampClkSrc = "DL_ADC12_CLOCK_ULPCLK";
ADC12Instance.adcMem0chansel = "DL_ADC12_INPUT_CHAN_2";
ADC12Instance.sampleTime0 = "62.5ns";
ADC12Instance.powerDownMode = "DL_ADC12_POWER_DOWN_MODE_MANUAL";
ADC12Instance.trigSrc = "DL_ADC12_TRIG_SRC_EVENT";
/* Keep ADC armed, but require one new Timer event for each conversion. */
ADC12Instance.repeatMode = true;
ADC12Instance.adcMem0trig = "DL_ADC12_TRIGGER_MODE_TRIGGER_NEXT";
ADC12Instance.subChanID = 1;
ADC12Instance.configureDMA = true;
ADC12Instance.sampCnt = 1;
ADC12Instance.enabledDMATriggers = ["DL_ADC12_DMA_MEM0_RESULT_LOADED"];
ADC12Instance.enabledInterrupts = ["DL_ADC12_INTERRUPT_DMA_DONE"];
ADC12Instance.peripheral.$assign = "ADC0";
ADC12Instance.peripheral.adcPin2.$assign = "PA25";
ADC12Instance.DMA_CHANNEL.$name = "SIGNAL_ADC_DMA";
ADC12Instance.DMA_CHANNEL.peripheral.$assign = "DMA_CH0";
ADC12Instance.DMA_CHANNEL.addressMode = "f2b";
ADC12Instance.DMA_CHANNEL.srcLength = "HALF_WORD";
ADC12Instance.DMA_CHANNEL.dstLength = "HALF_WORD";
/* 单帧完成后 DMA 自动关闭，避免 ISR 到来前的下一触发覆盖 buffer[0]。 */
ADC12Instance.DMA_CHANNEL.transferMode = "SINGLE";

TIMERInstance.$name = "SIGNAL_SAMPLE_TIMER";
TIMERInstance.timerClkSrc = "BUSCLK";
TIMERInstance.timerClkDiv = 1;
TIMERInstance.timerClkPrescale = 1;
TIMERInstance.timerPeriod = "10us";
TIMERInstance.timerMode = "PERIODIC";
TIMERInstance.event1PublisherChannel = 1;
TIMERInstance.event1ControllerInterruptEn = ["ZERO_EVENT"];
TIMERInstance.peripheral.$assign = "TIMG0";

/*
 * DEBUG / VALIDATION only：SysConfig 在此仅预留 PA12 并初始化为低电平。
 * Demo 启动后把 PA12 复用为同一 TIMG0 的 CCP0，并配置为在 ZERO_EVENT
 * 翻转。不能把 Event channel 1 再订阅给 GPIO，因为该通道的订阅者额度
 * 已由 ADC0 使用。正式 ADC_DMA 模块不依赖此引脚。
 */
ValidationGPIO.$name = "VALIDATION_TRIGGER_GPIO";
ValidationGPIO.associatedPins[0].$name = "TRIGGER_TOGGLE";
ValidationGPIO.associatedPins[0].direction = "OUTPUT";
ValidationGPIO.associatedPins[0].assignedPort = "PORTA";
ValidationGPIO.associatedPins[0].assignedPin = "12";
ValidationGPIO.associatedPins[0].initialValue = "CLEARED";
ValidationGPIO.associatedPins[0].pin.$assign = "PA12";

SYSCTL.forceDefaultClkConfig = true;
SYSCTL.clockTreeEn = true;
