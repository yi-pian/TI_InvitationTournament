/**
 *
 * @cliArgs --device "MSPM0G350X" --part "Default" --package "LQFP-64(PM)" --product "mspm0_sdk@2.11.00.07"
 * @versions {"tool":"1.28.0+4696"}
 */

/**
 * Import the modules used in this configuration.
 */
const ADC12  = scripting.addModule("/ti/driverlib/ADC12", {}, false);
const ADC121 = ADC12.addInstance();
const Board  = scripting.addModule("/ti/driverlib/Board");
const SYSCTL = scripting.addModule("/ti/driverlib/SYSCTL");
const TIMER  = scripting.addModule("/ti/driverlib/TIMER", {}, false);
const TIMER1 = TIMER.addInstance();

/**
 * Write custom configuration values to the imported modules.
 */
const fcc1      = system.clockTree["FCC"];
fcc1.enable     = true;
fcc1.fccPeriods = "02";

const mux5       = system.clockTree["EXLFMUX"];
mux5.inputSelect = "EXLFMUX_XTAL";

const mux6       = system.clockTree["FCCSELCLKMUX"];
mux6.inputSelect = "FCCSELCLKMUX_SYSOSC";

const mux7       = system.clockTree["FCCTRIGMUX"];
mux7.inputSelect = "FCCTRIGMUX_LFCLK";

const mux9       = system.clockTree["LFXTMUX"];
mux9.inputSelect = "LFXTMUX_TRUE";

const pinFunction6     = system.clockTree["LFXT"];
pinFunction6.enable    = true;
pinFunction6.inputFreq = 32.768;

ADC121.$name                          = "SIGNAL_ADC";
ADC121.sampClkSrc                     = "DL_ADC12_CLOCK_ULPCLK";
ADC121.adcMem0chansel                 = "DL_ADC12_INPUT_CHAN_5";
ADC121.sampleTime0                    = "3.25 us";
ADC121.powerDownMode                  = "DL_ADC12_POWER_DOWN_MODE_MANUAL";
ADC121.trigSrc                        = "DL_ADC12_TRIG_SRC_EVENT";
ADC121.subChanID                      = 1;
ADC121.configureDMA                   = true;
ADC121.sampCnt                        = 1;
ADC121.enabledDMATriggers             = ["DL_ADC12_DMA_MEM0_RESULT_LOADED"];
ADC121.enabledInterrupts              = ["DL_ADC12_INTERRUPT_DMA_DONE"];
ADC121.repeatMode                     = true;
ADC121.adcMem0trig                    = "DL_ADC12_TRIGGER_MODE_TRIGGER_NEXT";
ADC121.peripheral.$assign             = "ADC0";
ADC121.peripheral.adcPin5.$assign     = "PB24";
ADC121.adcPin5Config.$name            = "ti_driverlib_gpio_GPIOPinGeneric0";
ADC121.DMA_CHANNEL.$name              = "SIGNAL_ADC_DMA";
ADC121.DMA_CHANNEL.addressMode        = "f2b";
ADC121.DMA_CHANNEL.srcLength          = "HALF_WORD";
ADC121.DMA_CHANNEL.dstLength          = "HALF_WORD";
ADC121.DMA_CHANNEL.peripheral.$assign = "DMA_CH0";


SYSCTL.LFCLKSource           = "LFXT";
SYSCTL.fccClkSrc             = "SYSOSC";
SYSCTL.fccTrigSrc            = "LFCLK";
SYSCTL.fccPeriods            = "03";
SYSCTL.forceDefaultClkConfig = true;
SYSCTL.clockTreeEn           = true;

TIMER1.$name                       = "SIGNAL_SAMPLE_TIMER";
TIMER1.timerPeriod                 = "10us";
TIMER1.timerMode                   = "PERIODIC";
TIMER1.event1PublisherChannel      = 1;
TIMER1.event1ControllerInterruptEn = ["ZERO_EVENT"];
TIMER1.peripheral.$assign          = "TIMG0";

/**
 * Pinmux solution for unlocked pins/peripherals. This ensures that minor changes to the automatic solver in a future
 * version of the tool will not impact the pinmux you originally saw.  These lines can be completely deleted in order to
 * re-solve from scratch.
 */
pinFunction6.peripheral.$suggestSolution           = "SYSCTL";
pinFunction6.peripheral.lfxInPin.$suggestSolution  = "PA3";
pinFunction6.peripheral.lfxOutPin.$suggestSolution = "PA4";
Board.peripheral.$suggestSolution                  = "DEBUGSS";
Board.peripheral.swclkPin.$suggestSolution         = "PA20";
Board.peripheral.swdioPin.$suggestSolution         = "PA19";
